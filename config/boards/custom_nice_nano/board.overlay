/ {
    zephyr,bt-hci-rpmsg {
        status = "okay";
    };

    vbat {
        compatible = "voltage-divider";
        io-channels = <&adc 0>;
        output-ohms = <100000>;
        full-ohms = <200000>;
        power-supply = <&vdd>;
        status = "okay";
    };
};
